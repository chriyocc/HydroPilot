## firmware/esp32/main/Kconfig.projbuild
```kconfig
menu "System Configuration"

    orsource "$IDF_PATH/examples/common_components/env_caps/$IDF_TARGET/Kconfig.env_caps"

    menu "Actuator Simulation"
        config PUMP_LED_GPIO
            int "Pump LED GPIO"
            range ENV_GPIO_RANGE_MIN ENV_GPIO_OUT_RANGE_MAX
            default 8
            help
                GPIO used to simulate the pump relay state.

        config LIGHT_LED_GPIO
            int "Grow light LED GPIO"
            range ENV_GPIO_RANGE_MIN ENV_GPIO_OUT_RANGE_MAX
            default 9
            help
                GPIO used to simulate the grow light state.

        config NUTRIENT_PULSE_MS
            int "Nutrient pulse duration in ms"
            range 50 5000
            default 150
            help
                Length of each nutrient diagnostic LED pulse.
    endmenu

    menu "Telemetry Simulation"
        config TELEMETRY_PUBLISH_INTERVAL_MS
            int "Telemetry publish interval in ms"
            range 250 60000
            default 2000
            help
                Delay between simulated telemetry updates.
    endmenu

    menu "WiFi Station Configuration"
        config WIFI_SSID
            string "WiFi SSID"
            default "your_wifi_ssid"
            help
                SSID for the router the ESP32 should connect to.

        config WIFI_PASSWORD
            string "WiFi Password"
            default "your_wifi_password"
            help
                Password for the router the ESP32 should connect to.

        config WIFI_MAXIMUM_RETRY
            int "WiFi maximum retry count"
            range 1 100
            default 5
            help
                Maximum number of reconnect attempts after a disconnect event.
    endmenu

    menu "MQTT Runtime Configuration"
        config MQTT_BROKER_HOST
            string "MQTT broker host"
            default ""
            help
                Default broker host used before NVS configuration is written.

        config MQTT_BROKER_PORT
            int "MQTT broker port"
            range 1 65535
            default 1883
            help
                Default broker port used before NVS configuration is written.

        config MQTT_USERNAME
            string "MQTT username"
            default ""
            help
                Default MQTT username.

        config MQTT_PASSWORD
            string "MQTT password"
            default ""
            help
                Default MQTT password.

        config HYDRO_DEVICE_ID
            string "HydroPilot device ID"
            default "device-1"
            help
                Device identifier used for MQTT topics and health responses.

        config HYDRO_TOPIC_PREFIX
            string "HydroPilot topic prefix"
            default "hydro"
            help
                MQTT topic namespace prefix.
    endmenu

    menu "WiFi AP Configuration"
        config WIFI_AP_SSID
            string "WiFi SSID"
            default "your_wifi_ssid"
            help
                SSID for the ESP32 the user should connect to.

        config WIFI_AP_PASS
            string "WiFi Password"
            default "your_wifi_password"
            help
                Password for the ESP32 the user should connect to.

        config WIFI_AP_CHANNEL
            int "WiFi Channel"
            range 1 13
            default 1
            help
                Wi-Fi channel for the ESP32 SoftAP to operate on.

        config WIFI_AP_MAX_CONN
            int "WiFi maximum station connections"
            range 1 10
            default 4
            help
                Maximum number of stations that can connect to the ESP32 SoftAP.
    endmenu
endmenu
```
